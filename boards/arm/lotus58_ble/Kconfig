## boards/arm/lotus58_ble/Kconfig.board
```kconfig
# Copyright (c) 2024 Allister MacLeod
# SPDX-License-Identifier: MIT

config BOARD_LOTUS58_BLE_LEFT
       bool "Lotus 58 BLE left"
       depends on SOC_NRF52840_QIAA

config BOARD_LOTUS58_BLE_RIGHT
       bool "Lotus 58 BLE right"
       depends on SOC_NRF52840_QIAA
```
